## boards/shields/turing/Kconfig.defconfig
```kconfig
if SHIELD_TURING_LEFT

config ZMK_KEYBOARD_NAME
    default "Turing"

config ZMK_SPLIT_ROLE_CENTRAL
    default y

endif

if SHIELD_TURING_LEFT || SHIELD_TURING_RIGHT

config ZMK_SPLIT
    default y

endif
```

## boards/shields/turing/Kconfig.shield
```kconfig
# No whitespace after the comma or in your part name!
config SHIELD_TURING_LEFT
    def_bool $(shields_list_contains,turing_left)

# No whitespace after the comma or in your part name!
config SHIELD_TURING_RIGHT
    def_bool $(shields_list_contains,turing_right)
```
